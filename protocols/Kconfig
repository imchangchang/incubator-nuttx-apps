## protocols/Kconfig
```kconfig
#
#
# For a description of the syntax of this configuration file,
# see the file kconfig-language.txt in the NuttX tools repository.
#

menu "Protocol"

config PROTOCOLS_ENABLE
	bool "Protocols library enable"
	default n

if PROTOCOLS_ENABLE

endif # PROTOCOLS_ENABLE
endmenu # PROTOCOLS library
```

## underpan/Kconfig
```kconfig
#
#
# For a description of the syntax of this configuration file,
# see the file kconfig-language.txt in the NuttX tools repository.
#

menu "Underpan"

config UNDERPAN_ENABLE 
	bool "ENABLE UNDERPAN"
	default n

endmenu # UNDERPAN
```
